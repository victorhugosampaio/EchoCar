/**
 * @file display.c
 * @author victorhugosampaio
 * @brief SSD1306 display driver.
 * @version 0.1
 * @date 01-15-2025
 *
 * @note: Based on https://github.com/bokfink/esp32-zephyr-ssd1306-tutorialzephyr_esp32_ssd1306_yt5/tree/master
 * @note: Font: https://github.com/lynniemagoo/oled-font-pack/blob/master/fonts/5x7/oled-font-5x7.js
 *
 * @copyright Copyright (c) 2025
 *
 */


#include "display.h"

#include <errno.h>
#include <stdint.h>
#include <zephyr/device.h>
#include <zephyr/kernel.h>
#include <zephyr/drivers/display.h>
#include <zephyr/logging/log.h>

/**
 * @brief OLED display specs.
 */
#define DISPLAY_WIDTH 128
#define DISPLAY_HEIGHT 64

/**
 * @brief Display maximum buffer size.
 */
#define DISPLAY_MAX_BUFFER_SIZE DISPLAY_WIDTH * DISPLAY_HEIGHT

/**
 * @brief Font char size.
 */
#define CHAR_WIDTH 5
#define CHAR_HEIGHT 7

/**
 * @brief String maximum width.
 */
#define STRING_MAX_WIDTH DISPLAY_WIDTH / CHAR_WIDTH

LOG_MODULE_REGISTER(display);

/**
 * @brief Add a char to the display buffer.
 *
 * @param c Char to be added. 
 */
static void add_char(char c);

/**
 * @brief Clear the display buffer.
 */
static void clr_display_buf(void);

/**
 * @brief Container that holds the display device.
 */
static const struct device *display = DEVICE_DT_GET(DT_NODELABEL(ssd1306));

/**
 * @brief Display buffer.
 */
static uint8_t display_buf[DISPLAY_MAX_BUFFER_SIZE];

/**
 * @brief Display buffer index.
 */
static int buf_idx;

/**
 * @brief Container that holds the display buffer params.
 */
static struct display_buffer_descriptor display_buf_desc = {
    .width = DISPLAY_WIDTH,
    .height = DISPLAY_HEIGHT,
    .buf_size = DISPLAY_MAX_BUFFER_SIZE,
    .pitch = DISPLAY_WIDTH,
};

/**
 * @brief 5x7 font.
 */
static const uint8_t font[455] = {
    0x00, 0x00, 0x00, 0x00, 0x00, // (space)
    0x00, 0x00, 0x5F, 0x00, 0x00, // !
    0x00, 0x07, 0x00, 0x07, 0x00, // "
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    0x44, 0x64, 0x54, 0x4C, 0x44, // z
};

int display_init(void) {
    if (display == NULL) {
        LOG_ERR("device pointer is NULL");
        return -EFAULT;
    }

    if (!device_is_ready(display) ) {
        LOG_ERR("display device is not ready");
        return -EBUSY;
    }

    clr_display_buf();

    return 0;
}

void add_string(char *str) {
    uint8_t idx = 0;

    for (int pos = 0; str[pos] != '\0'; pos++) {
        if (str[pos] == '\n') {
            buf_idx += 5 * (STRING_MAX_WIDTH - idx) + 3;
            idx = 0;
            continue;
        }

        if (idx >= STRING_MAX_WIDTH) {
            continue;
        }

        add_char(str[pos]);
        idx++;
    }
}

int display_print(void) {
    if (display_write(display, 0, 0, &display_buf_desc, display_buf) != 0) {
        LOG_ERR("could not write to display");
        return -EBUSY;
    }

   clr_display_buf();

    return 0;
}

static void add_char(char c) {
    uint8_t index = c - ' ';
    uint16_t start = index * 5;

    if (buf_idx >= DISPLAY_MAX_BUFFER_SIZE) {
        return;
    }

    for (int i = 0; i < 5; i++) {
        display_buf[buf_idx] = font[start + i];
        buf_idx++;
    }
}

static void clr_display_buf(void) {
     buf_idx = 0;

    for (uint16_t i = 0; i < DISPLAY_MAX_BUFFER_SIZE; i++) {
        display_buf[i] = 0x00;
    }
}